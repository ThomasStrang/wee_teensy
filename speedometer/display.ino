#include <Adafruit_GFX.h>
#include <Adafruit_ST7735.h>
#include <SPI.h>

uint16_t parse_colour(uint16_t r, uint16_t g, uint16_t b) {
  return (b<<11)+(g*2<<5)+r;
}

uint16_t COLOUR_BLACK = parse_colour(0,0,0);
uint16_t COLOUR_RED = parse_colour(18,0,0);
uint16_t COLOUR_REDDER = parse_colour(31,0,0);
uint16_t COLOUR_LIME = parse_colour(4,16,24);
uint16_t COLOUR_WHITE = parse_colour(31,31,31);
uint16_t COLOUR_PIKACHU = parse_colour(30,28,0);
uint16_t COLOUR_PIKACHU_LIGHT = parse_colour(31,29,15);
uint16_t COLOUR_BACKGROUND = COLOUR_BLACK;

Adafruit_ST7735 tft_display = Adafruit_ST7735(&SPI1,9,8,12);

class Drawable {
  protected:
    uint8_t x;
    uint8_t y;
    Adafruit_ST7735* tft;
    
  public:
    Drawable(Adafruit_ST7735* tft, uint8_t x, uint8_t y) : tft{tft}, x{x}, y{y} {}
    void draw();
    void undraw();
};

class StringDrawer : Drawable {
  private:
    char* str;
    uint8_t num_chars;

    void _draw(uint16_t colour) {
      tft->setCursor(x,y);
      tft->setTextWrap(true);
      tft->setTextSize(3);
      tft->setTextColor(colour);
      tft->print(str);
    }
  
  public:
  
    StringDrawer(Adafruit_ST7735* tft, uint8_t x, uint8_t y, char* str, uint8_t num_chars): Drawable(tft,x,y), str{str}, num_chars{num_chars} {}
    
    void draw() {
      _draw(COLOUR_WHITE);
    }
    
    void undraw() {
      _draw(COLOUR_BACKGROUND);
    }

    void update_string(char* new_str) {
      for(int i =0;i<num_chars;i++){
        if(new_str[i]!=str[i]) {
          undraw();
          for(int j =0;j<num_chars;j++){
            str[j]=new_str[j];
          }
          draw();
          break;
        }
      }
    }
}; 

class GraphDrawer : Drawable {
  private:
    uint8_t internal_y;
    uint8_t num_x_pixels;
    uint8_t num_y_pixels;
    uint8_t* pixels;//the y position of each x pixel
    float y_scale=100;
    float x_scale=100;
    char* title;
 
  public:
    
    GraphDrawer(Adafruit_ST7735* tft, uint8_t x, uint8_t y, uint8_t num_x_pixels, uint8_t num_y_pixels, float x_scale, float y_scale, char* title) : Drawable(tft,x,y), num_x_pixels{num_x_pixels}, num_y_pixels{num_y_pixels}, x_scale{x_scale}, y_scale{y_scale}, title{title} {
      pixels = (uint8_t*) calloc(num_x_pixels,sizeof(uint8_t));
      internal_y=y+num_y_pixels-1;
    }
  
    ~GraphDrawer() {
      free(pixels); 
    }

    void draw_title(uint16_t colour) {
      tft->setCursor(x+2, y+2);
      tft->setTextColor(colour);
      tft->setTextWrap(true);
      tft->print(title);
    }

    void draw_border(uint16_t colour) {
        tft->drawFastHLine(x-2, y-2, num_x_pixels+4, colour);
        tft->drawFastHLine(x-2, y+num_y_pixels+2, num_x_pixels+4, colour);
        tft->drawFastVLine(x-2, y-2, num_y_pixels+4, colour);
        tft->drawFastVLine(x+num_x_pixels+2, y-2, num_y_pixels+4, colour);
    }

    void draw_border() {
        draw_border(COLOUR_RED);
    }


    uint8_t graph_y_to_display_y(uint8_t y) {
      return internal_y-y;
    }

    uint8_t graph_x_to_display_x(uint8_t graph_x) {
      return x+graph_x;
    }
  
    void draw() {
      for(uint8_t x = 0; x < num_x_pixels; x++) {
        tft->drawPixel(graph_x_to_display_x(x), graph_y_to_display_y(pixels[x]), COLOUR_WHITE);
      }
      draw_border();
      draw_title(COLOUR_PIKACHU);
    }
    
    void undraw() {
      for(uint8_t x = 0; x < num_x_pixels; x++) 
        tft->drawPixel(graph_x_to_display_x(x), graph_y_to_display_y(pixels[x]), COLOUR_BACKGROUND);
      draw_border(COLOUR_BACKGROUND);
      draw_title(COLOUR_BACKGROUND);
    }
    
    void move_graph_and_draw(uint8_t new_x, uint8_t new_y) {
      undraw();
      x = new_x;
      y = new_y;
      internal_y=new_y+num_y_pixels-1;
      draw();
    }
    
    uint8_t x_val_to_pixel_num(float x) {
      float x_fraction_of_graph = x/x_scale;
      uint8_t return_val = (uint8_t) ((int)round((x_fraction_of_graph * (float)num_x_pixels)) % num_x_pixels);
      return return_val;
    }

    uint8_t y_val_to_pixel_num(float y) {
      float y_fraction_of_graph = y/y_scale;
      uint8_t return_val = (uint8_t) (((int)round((y_fraction_of_graph * (float)num_y_pixels))) % num_y_pixels);
      return return_val;
    }

    void draw_pixel(uint8_t x_pixel, uint8_t y_pixel) {
      if(pixels[x_pixel]!=y_pixel) {
        tft->drawPixel(graph_x_to_display_x(x_pixel), graph_y_to_display_y(pixels[x_pixel]), COLOUR_BACKGROUND);
        tft->drawPixel(graph_x_to_display_x(x_pixel), graph_y_to_display_y(y_pixel), COLOUR_WHITE);
        pixels[x_pixel]=y_pixel;
      }
    }

    void draw_xy(float x, float y) {
      uint8_t x_pixel=x_val_to_pixel_num(x);
      uint8_t y_pixel=y_val_to_pixel_num(y);
      this->draw_pixel(x_pixel,y_pixel);
    }

    void move_pixels_over() {
      for(int i = 0; i < num_x_pixels-1; i ++) {
        this->draw_pixel(i, pixels[i+1]);
      }
    }

    void add_val_to_end(float y) {
      this->move_pixels_over();
      this->draw_pixel(num_x_pixels-1, y_val_to_pixel_num(y));
    }
};

class Sprite : Drawable {
  private:
    int num_pixels;
    byte* image_buffer;
    
  public:
  
    Sprite(Adafruit_ST7735* tft, int num_pixels, byte* image_buffer, uint16_t x, uint16_t y) : Drawable(tft,x,y), num_pixels{num_pixels}, image_buffer{image_buffer} {}
    
    void draw() {
      for(uint16_t i = 0; i < num_pixels; i++){
        byte red=image_buffer[i*4]>>3;
        byte green=image_buffer[i*4+1]>>3;
        byte blue=image_buffer[i*4+2]>>3;
        byte gamma=image_buffer[i*4+3]>>3;
        uint16_t row = i>>6;
        if(gamma) {
          tft->drawPixel(x+i%64,y+row,parse_colour(red,green,blue));//TODO parse this once, throw out the unneccessarily large buffer, keep the parsed
        }
      }
    }
    
    void undraw() {
      for(uint16_t i = 0; i < num_pixels; i++){
        byte gamma=image_buffer[i*4+3]>>3;
        uint16_t row = i>>6;
        if(gamma) {
          tft->drawPixel(x+i%64,y+row,COLOUR_BACKGROUND);//TODO parse this once, throw out the unneccessarily large buffer, keep the parsed
        }
      }
    }
};

char input_high_title[] ="Voltage Readings";
GraphDrawer voltage_graph_drawer = GraphDrawer(&tft_display, 10,45, 140, 78, 100, 1023, input_high_title);
byte pikachu_image[] = { 0, 0, 0, 0, 0, 0, 0, 0, 0, 0, 0, 0, 0,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 0, 0 };
Sprite pikachu_drawer = Sprite(&tft_display, 4096, pikachu_image, 103,4);
char voltage_string[] = "00.00V";
StringDrawer voltage_drawer = StringDrawer(&tft_display,10,10,voltage_string,6);

void setup_display() {
  SPI1.setCS(9);
  SPI1.setSCK(10);
  SPI1.setTX(11);
  SPI1.begin(true);
  tft_display.initR(INITR_GREENTAB);
  tft_display.setRotation(3);
  tft_display.fillScreen(COLOUR_BACKGROUND);
  pinMode(13, OUTPUT);
  analogWrite(13, 32);
  voltage_graph_drawer.draw();
  pikachu_drawer.draw();
  voltage_drawer.draw();
}
