#include <Adafruit_GFX.h>
#include <Adafruit_ST7735.h>
#include <SPI.h>

//inputs are connected to ground via 68000 ohms and to the terminals via 200000 ohms. 
//total resistance 268000 ohms. 
//voltage reduction is 68/268 -> 13V is read as 3.3V. 
//1023 means 13V, so reading to 
// Not sure on the specifics as to why, but the pico gives a reading of  22 even when connected to ground.
#define READING_TO_VOLTAGE 0.01270772238

uint16_t parse_colour(uint16_t r, uint16_t g, uint16_t b) {
  return (b<<11)+(g*2<<5)+r;
}

uint16_t COLOUR_BLACK = parse_colour(0,0,0);
uint16_t COLOUR_RED = parse_colour(18,0,0);
uint16_t COLOUR_REDDER = parse_colour(31,0,0);
uint16_t COLOUR_LIME = parse_colour(4,16,24);
uint16_t COLOUR_WHITE = parse_colour(31,31,31);
uint16_t COLOUR_PIKACHU = parse_colour(30,28,0);
uint16_t COLOUR_PIKACHU_LIGHT = parse_colour(31,29,15);
uint16_t COLOUR_BACKGROUND = COLOUR_BLACK;



Adafruit_ST7735 tft = Adafruit_ST7735(&SPI1,9,8,12);

class GraphDrawer {
  public:
    uint8_t x_offset;
    uint8_t y_offset;
    uint8_t _internal_y_offset;
    uint8_t num_x_pixels;
    uint8_t num_y_pixels;
    uint8_t* pixels;//the y position of each x pixel

    float y_scale=100;
    float x_scale=100;

    char* title;
    
    GraphDrawer(uint8_t x_offset, uint8_t y_offset, uint8_t num_x_pixels, uint8_t num_y_pixels, float x_scale, float y_scale, char* title) : x_offset{x_offset}, y_offset{y_offset}, num_x_pixels{num_x_pixels}, num_y_pixels{num_y_pixels}, x_scale{x_scale}, y_scale{y_scale}, title{title} {
      pixels = (uint8_t*) calloc(num_x_pixels,sizeof(uint8_t));
      _internal_y_offset=y_offset+num_y_pixels-1;
    }
  
    ~GraphDrawer() {
      free(pixels); 
    }

    void draw_title(uint16_t colour) {
      tft.setCursor(x_offset+2, y_offset+2);
      tft.setTextColor(colour);
      tft.setTextWrap(true);
//      tft.setTextSize(2);
      tft.print(title);
    }

    void draw_title() {
      draw_title(COLOUR_PIKACHU);
    }

    void _undraw_title() {
      draw_title(COLOUR_BACKGROUND);
    }

    void draw_border(uint16_t colour) {
        tft.drawFastHLine(x_offset-2, y_offset-2, num_x_pixels+4, colour);
        tft.drawFastHLine(x_offset-2, y_offset+num_y_pixels+2, num_x_pixels+4, colour);
        tft.drawFastVLine(x_offset-2, y_offset-2, num_y_pixels+4, colour);
        tft.drawFastVLine(x_offset+num_x_pixels+2, y_offset-2, num_y_pixels+4, colour);
    }

    void draw_border() {
        draw_border(COLOUR_RED);
    }

    void _undraw_border() {
        draw_border(COLOUR_BACKGROUND);
    }

    uint8_t graph_y_to_display_y(uint8_t y) {
      return _internal_y_offset-y;
    }

    uint8_t graph_x_to_display_x(uint8_t x) {
      return x_offset+x;
    }
  
  
    void clear_graph() {
      for(uint8_t x = 0; x < num_x_pixels; x++) 
        tft.drawPixel(graph_x_to_display_x(x), graph_y_to_display_y(pixels[x]), COLOUR_BACKGROUND);
      _undraw_border();
      _undraw_title();
    }
    
    void draw_graph() {
      for(uint8_t x = 0; x < num_x_pixels; x++) {
        tft.drawPixel(graph_x_to_display_x(x), graph_y_to_display_y(pixels[x]), COLOUR_WHITE);
      }
      draw_border();
      draw_title();
    }

    void move_graph(uint8_t new_x_offset, uint8_t new_y_offset) {
      clear_graph();
      x_offset = new_x_offset;
      y_offset = new_y_offset;
      _internal_y_offset=new_y_offset+num_y_pixels-1;
      draw_graph();
    }
    
    uint8_t x_val_to_pixel_num(float x) {
      float x_fraction_of_graph = x/x_scale;
      uint8_t return_val = (uint8_t) ((int)round((x_fraction_of_graph * (float)num_x_pixels)) % num_x_pixels);
      return return_val;
    }

    uint8_t y_val_to_pixel_num(float y) {
      float y_fraction_of_graph = y/y_scale;
      uint8_t return_val = (uint8_t) (((int)round((y_fraction_of_graph * (float)num_y_pixels))) % num_y_pixels);
      return return_val;
    }

    void draw_pixel(uint8_t x_pixel, uint8_t y_pixel) {
      if(pixels[x_pixel]!=y_pixel) {
        tft.drawPixel(graph_x_to_display_x(x_pixel), graph_y_to_display_y(pixels[x_pixel]), COLOUR_BACKGROUND);
        tft.drawPixel(graph_x_to_display_x(x_pixel), graph_y_to_display_y(y_pixel), COLOUR_WHITE);
        pixels[x_pixel]=y_pixel;
      }
      
    }

    void draw(float x, float y) {
      uint8_t x_pixel=x_val_to_pixel_num(x);
      uint8_t y_pixel=y_val_to_pixel_num(y);
      this->draw_pixel(x_pixel,y_pixel);
    }

    void move_pixels_over() {
      for(int i = 0; i < num_x_pixels-1; i ++) {
        this->draw_pixel(i, pixels[i+1]);
      }
    }

    void add_val_to_end(float y) {
      this->move_pixels_over();
      this->draw_pixel(num_x_pixels-1, y_val_to_pixel_num(y));
    }
};



char input_high_title[] ="Voltage Readings";
GraphDrawer input_high_graph = GraphDrawer(10,45, 140, 78, 100, 1023, input_high_title);

//char text[] = "Lorem ipsum dolor sit amet, consectetur adipiscing elit, sed do eiusmod tempor incididunt ut labore et dolore magna aliqua. Ut enim ad minim veniam, quis nostrud exercitation ullamco laboris nisi ut aliquip ex ea commodo consequat. Duis aute irure dolor in reprehenderit in voluptate velit esse cillum dolore eu fugiat nulla pariatur. Excepteur sint occaecat cupidatat non proident, sunt in culpa qui officia deserun";
//void testdrawtext(char *text, uint16_t color) {
//  tft.setCursor(0, 0);
//  tft.setTextColor(color);
//  tft.setTextWrap(true);
//  tft.print(text);
//}

const byte pikachu_image[] = { 0, 0, 0, 0, 0, 0, 0, 0, 0, 0, 0, 0, 0,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 0, 0 };
const int num_pixels_in_pikachu=4096;

void undraw_pikachu(uint16_t x_offset, uint16_t y_offset) {
  for(uint16_t i = 0; i < num_pixels_in_pikachu; i++){
    byte gamma=pikachu_image[i*4+3]>>3;
    uint16_t row = i>>6;
    if(gamma) {
      tft.drawPixel(x_offset+i%64,y_offset+row,COLOUR_BACKGROUND);
    }
  }
  
}

void draw_pikachu(uint16_t x_offset, uint16_t y_offset) {
  for(uint16_t i = 0; i < num_pixels_in_pikachu; i++){
    byte red=pikachu_image[i*4]>>3;
    byte green=pikachu_image[i*4+1]>>3;
    byte blue=pikachu_image[i*4+2]>>3;
    byte gamma=pikachu_image[i*4+3]>>3;
    uint16_t row = i>>6;
    if(gamma) {
      tft.drawPixel(x_offset+i%64,y_offset+row,parse_colour(red,green,blue));
    }
  }
}

void setup_rendering() {
  SPI1.setCS(9);
  SPI1.setSCK(10);
  SPI1.setTX(11);
  SPI1.begin(true);
  tft.initR(INITR_GREENTAB);
  tft.setRotation(3);
  tft.fillScreen(COLOUR_BACKGROUND);
  pinMode(13, OUTPUT);
  analogWrite(13, 32);
  input_high_graph.draw_graph();
}


char drawn_voltage[] = "00.00V";
char new_voltage_str[] = "00.00V";

void update_drawn_voltage(float f) {
  new_voltage_str[0]=int(f/10)+48;//48 because of the ascii table
  new_voltage_str[1]=int(f)%10+48;
  new_voltage_str[2]='.';
  new_voltage_str[3]=int(f*10)%10+48;
  new_voltage_str[4]=int(f*100)%10+48;
  new_voltage_str[5]='V';
  for(int i =0;i<6;i++){
    if(new_voltage_str[i]!=drawn_voltage[i]) {
      tft.setCursor(10,10);
      tft.setTextColor(COLOUR_BACKGROUND);
      tft.setTextWrap(true);
      tft.setTextSize(3);
      tft.print(drawn_voltage);
      tft.setTextColor(COLOUR_WHITE);
      tft.setCursor(10,10);
      tft.print(new_voltage_str);
      for(int j=0;j<6;j++){
        drawn_voltage[j]=new_voltage_str[j];
      }
      break;
    }
  }
}

float input_reading_to_voltage(int input_reading) {
  return input_reading*READING_TO_VOLTAGE;
}

void update_input_voltage(int input_reading) {
  update_drawn_voltage(input_reading_to_voltage(input_reading));
  input_high_graph.add_val_to_end(input_reading);
}

uint16_t pikachu_x_offset=103;
uint16_t pikachu_y_offset=4;

void draw_stuff() {
  draw_pikachu(pikachu_x_offset, pikachu_y_offset);
}
